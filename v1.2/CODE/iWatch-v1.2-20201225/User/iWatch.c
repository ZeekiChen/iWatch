#include "iWatch.h"

/*******************iWatch工作状态相关变量**********************/
unsigned char bdata iWatch_status = 0x06;
sbit action = 						 iWatch_status^0;		//动态标志位，当有按键被按下，双击屏幕或抬腕动作，此位置1
sbit screen_on_flag = 		 iWatch_status^1;		//屏幕状态标志位
sbit active_flag = 				 iWatch_status^2;		//活动标志位，当处于活动状态时，此为1
sbit idle_flag = 					 iWatch_status^3;		//空闲标志位，当在设定的时长内没有动作产生，此为被置1且屏幕被关闭
sbit going_to_sleep_flag = iWatch_status^4;
sbit sleep_flag = 				 iWatch_status^5;		//睡眠标志位，当在设定的时长内没有动作产生，单片机停止运转，进入睡眠状态
sbit powerdown_flag = 		 iWatch_status^6;		//掉电标志位，当在设定的时长内没有动作产生，单片机停止运转且3.3v的输出被关闭，此时系统功耗最低
static unsigned int inactive_time = 0;	//不活跃的时间，没有动作产生所持续的时长
static unsigned int idle_time = 0;			//空闲状态下持续的时间
static int autowake_cnt = 0;						//自动唤醒的次数
/***************************************************************/
iWatch_config config;			//设置信息
pcf8563_time time;				//时间信息
float battery_life;  			//电池电量
bit PCF8563_int_flag;			//PCF8563中断产生标志位

extern unsigned char xdata main_cache[1024];	//主显存

//若EEPROM中没有数据或者数据不完整，则加载以下默认设置
static code iWatch_config default_config = {
	//0,
	//默认显示参数
	5,						//自动息屏时间
	1,						//开启抬腕唤醒
	0,						//关闭常亮显示
	10,						//屏幕亮度（0~100）
	0,						//屏幕是否反色
	OFF,					//关闭按键音
	//默认闹钟参数
	8,							//小时
	30,							//分钟
	1,							//1号
	1,							//周一
	ALARM_DISABLE,	//闹钟关闭
	//默认校正参数
	0,			//x轴倾角偏移
	0,			//y轴倾角偏移
	0,			//磁力计校正系数
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	{{0}, {0}, {0}, {0}, {0}, {0}, {0}},	//计步器的历史数据，存放过去七天的步数
	0				//检验用求和项，不要修改
};
static unsigned char code watch_digit_num[10][224] = 
{
	{//0
		0x00,0x00,0x80,0xC0,0xE0,0xE0,0xC0,0x8C,0x1E,0x3F,0x3F,0x3F,0x3F,0x3F,0x3F,0x3F,
		0x3F,0x3F,0x3F,0x1E,0x8C,0xC0,0xE0,0xE0,0xC0,0x80,0x00,0x00,0x00,0x00,0xFF,0xFF,
		0xFF,0xFF,0xFF,0xFF,0x00,0x00,0x00,0x00,0x00,0x00,0x00,0x00,0x00,0x00,0x00,0x00,
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		0xFC,0xFC,0xFC,0xFC,0xFC,0xFC,0xFC,0x78,0x31,0x03,0x07,0x07,0x03,0x01,0x00,0x00
		/* (28 X 64 )*/
	},
	{//1
		0x00,0x00,0x00,0x00,0x00,0x00,0x00,0x00,0x00,0x00,0x00,0x00,0x00,0x00,0x00,0x00,
		0x00,0x00,0x00,0x00,0x80,0xC0,0xE0,0xE0,0xC0,0x80,0x00,0x00,0x00,0x00,0x00,0x00,
		0x00,0x00,0x00,0x00,0x00,0x00,0x00,0x00,0x00,0x00,0x00,0x00,0x00,0x00,0x00,0x00,
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		0x00,0x00,0x00,0x00,0x00,0x00,0x00,0x00,0x01,0x03,0x07,0x07,0x03,0x01,0x00,0x00
		/* (28 X 64 )*/
	},
	{//2
		0x00,0x00,0x00,0x00,0x00,0x00,0x00,0x0C,0x1E,0x3F,0x3F,0x3F,0x3F,0x3F,0x3F,0x3F,
		0x3F,0x3F,0x3F,0x1E,0x8C,0xC0,0xE0,0xE0,0xC0,0x80,0x00,0x00,0x00,0x00,0x00,0x00,
		0x00,0x00,0x00,0x00,0x00,0x00,0x00,0x00,0x00,0x00,0x00,0x00,0x00,0x00,0x00,0x00,
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		0xFC,0xFC,0xFC,0xFC,0xFC,0xFC,0xFC,0x78,0x30,0x00,0x00,0x00,0x00,0x00,0x00,0x00
		/* (28 X 64 )*/
	},
	{//3
		0x00,0x00,0x00,0x00,0x00,0x00,0x00,0x0C,0x1E,0x3F,0x3F,0x3F,0x3F,0x3F,0x3F,0x3F,
		0x3F,0x3F,0x3F,0x1E,0x8C,0xC0,0xE0,0xE0,0xC0,0x80,0x00,0x00,0x00,0x00,0x00,0x00,
		0x00,0x00,0x00,0x00,0x00,0x00,0x00,0x00,0x00,0x00,0x00,0x00,0x00,0x00,0x00,0x00,
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		0xFC,0xFC,0xFC,0xFC,0xFC,0xFC,0xFC,0x78,0x31,0x03,0x07,0x07,0x03,0x01,0x00,0x00
		/* (28 X 64 )*/
	},
	{//4
		0x00,0x00,0x80,0xC0,0xE0,0xE0,0xC0,0x80,0x00,0x00,0x00,0x00,0x00,0x00,0x00,0x00,
		0x00,0x00,0x00,0x00,0x80,0xC0,0xE0,0xE0,0xC0,0x80,0x00,0x00,0x00,0x00,0xFF,0xFF,
		0xFF,0xFF,0xFF,0xFF,0x00,0x00,0x00,0x00,0x00,0x00,0x00,0x00,0x00,0x00,0x00,0x00,
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		0x00,0x00,0x00,0x00,0x00,0x00,0x00,0x00,0x01,0x03,0x07,0x07,0x03,0x01,0x00,0x00
		/* (28 X 64 )*/
	},
	{//5
		0x00,0x00,0x80,0xC0,0xE0,0xE0,0xC0,0x8C,0x1E,0x3F,0x3F,0x3F,0x3F,0x3F,0x3F,0x3F,
		0x3F,0x3F,0x3F,0x1E,0x0C,0x00,0x00,0x00,0x00,0x00,0x00,0x00,0x00,0x00,0xFF,0xFF,
		0xFF,0xFF,0xFF,0xFF,0x00,0x00,0x00,0x00,0x00,0x00,0x00,0x00,0x00,0x00,0x00,0x00,
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		0xFC,0xFC,0xFC,0xFC,0xFC,0xFC,0xFC,0x78,0x31,0x03,0x07,0x07,0x03,0x01,0x00,0x00
		/* (28 X 64 )*/
	},
	{//6
		0x00,0x00,0x80,0xC0,0xE0,0xE0,0xC0,0x8C,0x1E,0x3F,0x3F,0x3F,0x3F,0x3F,0x3F,0x3F,
		0x3F,0x3F,0x3F,0x1E,0x0C,0x00,0x00,0x00,0x00,0x00,0x00,0x00,0x00,0x00,0xFF,0xFF,
		0xFF,0xFF,0xFF,0xFF,0x00,0x00,0x00,0x00,0x00,0x00,0x00,0x00,0x00,0x00,0x00,0x00,
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		0xFC,0xFC,0xFC,0xFC,0xFC,0xFC,0xFC,0x78,0x31,0x03,0x07,0x07,0x03,0x01,0x00,0x00
		/* (28 X 64 )*/
	},
	{//7
		0x00,0x00,0x00,0x00,0x00,0x00,0x00,0x0C,0x1E,0x3F,0x3F,0x3F,0x3F,0x3F,0x3F,0x3F,
		0x3F,0x3F,0x3F,0x1E,0x8C,0xC0,0xE0,0xE0,0xC0,0x80,0x00,0x00,0x00,0x00,0x00,0x00,
		0x00,0x00,0x00,0x00,0x00,0x00,0x00,0x00,0x00,0x00,0x00,0x00,0x00,0x00,0x00,0x00,
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		0x00,0x00,0x00,0x00,0x00,0x00,0x00,0x00,0x01,0x03,0x07,0x07,0x03,0x01,0x00,0x00
		/* (28 X 64 )*/
	},
	{//8
		0x00,0x00,0x80,0xC0,0xE0,0xE0,0xC0,0x8C,0x1E,0x3F,0x3F,0x3F,0x3F,0x3F,0x3F,0x3F,
		0x3F,0x3F,0x3F,0x1E,0x8C,0xC0,0xE0,0xE0,0xC0,0x80,0x00,0x00,0x00,0x00,0xFF,0xFF,
		0xFF,0xFF,0xFF,0xFF,0x00,0x00,0x00,0x00,0x00,0x00,0x00,0x00,0x00,0x00,0x00,0x00,
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		0xFC,0xFC,0xFC,0xFC,0xFC,0xFC,0xFC,0x78,0x31,0x03,0x07,0x07,0x03,0x01,0x00,0x00
		/* (28 X 64 )*/
	},
	{//9
		0x00,0x00,0x80,0xC0,0xE0,0xE0,0xC0,0x8C,0x1E,0x3F,0x3F,0x3F,0x3F,0x3F,0x3F,0x3F,
		0x3F,0x3F,0x3F,0x1E,0x8C,0xC0,0xE0,0xE0,0xC0,0x80,0x00,0x00,0x00,0x00,0xFF,0xFF,
		0xFF,0xFF,0xFF,0xFF,0x00,0x00,0x00,0x00,0x00,0x00,0x00,0x00,0x00,0x00,0x00,0x00,
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		0xFC,0xFC,0xFC,0xFC,0xFC,0xFC,0xFC,0x78,0x31,0x03,0x07,0x07,0x03,0x01,0x00,0x00
		/* (28 X 64 )*/
	}
};
static unsigned char code watch_digit_colon[] = 
{
	0x00,0x00,0x00,0x00,0x00,0x00,0x00,0x00,0x00,0x00,0x00,0x00,0x00,0x00,0x00,0x00,
	0x00,0x00,0x00,0x00,0x00,0x00,0x80,0x80,0x80,0x80,0x00,0x00,0x00,0x00,0x00,0x00,
	0x00,0x00,0x00,0x00,0x1E,0x3F,0x7F,0x7F,0x7F,0x7F,0x3F,0x1E,0x00,0x00,0x00,0x00,
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	0x00,0x00,0x00,0x00,0x00,0x00,0x00,0x00,0x00,0x00,0x00,0x00,0x00,0x00,0x00,0x00
	/* (16 X 64 )*/
};
	
void TM3_Isr() interrupt 19 using 1		//MCU定时器1ms中断
{
	static unsigned int t_count = 0;
	AUXINTIF &= ~T3IF;						//清除中断标志位
	PageTick();										//页面节拍
	if(t_count % T_KEYSCAN == 0)	//按键扫描
		KeyScan();			
	if((K1 == 0) && (K2 == 0) && (K3 == 0))//三个按键均按下	
			MCUSoftReset();						//软复位MCU
	if(++t_count == 1000)
	{
		t_count = 0;
		iWatchStatusUpdate();				//每秒钟执行一次状态更新
	}
}
void INT0_Isr() interrupt 0		//PCF8563中断
{
	PCF8563_int_flag = 1;
}
void iWatchStatusUpdate(void)
{
	if(active_flag)
	{
		if(++inactive_time >= config.t_inactive_max)
		{
			active_flag = 0;
			inactive_time = 0;
			idle_flag = 1;
			idle_time = 0;
		}
	}
	if(idle_flag)
	{
		if(++idle_time >= 5)
		{
			idle_flag = 0;
			idle_time = 0;
			going_to_sleep_flag = 1;
		}
	}
}
void iWatchStatusHandle(void)
{
	if(action)
	{
		action = 0;
		if(active_flag)
		{
			inactive_time = 0;
		}
		else if(idle_flag)
		{
			idle_flag = 0;
			idle_time = 0;
			active_flag = 1;
			ScreenOnOff(ON);
			screen_on_flag = 1;
		}
		else if(sleep_flag)
		{
			sleep_flag = 0;
			active_flag = 1;
			SystemWake();
			ScreenOnOff(ON);
			screen_on_flag = 1;
			PageOpenCurrentPage();
		}
		else if(powerdown_flag)
		{
			MCUSoftReset();
		}
		autowake_cnt = 0;
	}
	if(idle_flag)
	{
		if(screen_on_flag)
		{
			ScreenOnOff(OFF);
			screen_on_flag = 0;
		}
	}
	if(going_to_sleep_flag)
	{
		going_to_sleep_flag = 0;
		PageCloseCurrentPage();
		sleep_flag = 1;
	}
	if(sleep_flag)
	{
		if(config.always_on_disp == 0)
		{
			ScreenOnOff(OFF);
			screen_on_flag = 0;
		}
		else
		{
			ScreenOnOff(ON);
			screen_on_flag = 1;
		}
		if(PageGetStatus() == 0)
		{
			iWatchAlwaysOn();
			SystemSleep();
		}
	}
	if(powerdown_flag)		
	{
		SystemPowerDown();
	}
}
void iWatchKeepActive(void)
{
	active_flag = 1;
	inactive_time = 0;
}
unsigned char iWatchGetStatus(void)
{
	return iWatch_status;
}
void iWatchAutoWakeHandle(void)
{
	if(PCF8563_int_flag)
	{
		unsigned char pcf8563_int_src;
		PCF8563_int_flag = 0;
		pcf8563_int_src = PCF8563ReadIntSrc();	//读PCF8563状态寄存器
		PCF8563ReadTime(&time);
		battery_life = iWatchGetBatteryLife();
		if(pcf8563_int_src & TIMER_INT)				//如果是定时器中断
		{
			PCF8563ClearTimerFlag();	//清除定时器中断标志位
			//PCF8563以固定的时间间隔唤醒MCU
			//唤醒之后执行以下内容
			if(sleep_flag || powerdown_flag)
			{
				if(config.always_on_disp != 0)
					iWatchAlwaysOn();
			}
			if((time.hour == 22) && (time.minute == 4))		//22:04,记录当天的步数数据
			{
				char i, j;
				for(i = 6; i > 0; i--)
				{
					for(j = 0; j < 10; j++)
					{
						config.history_step[i][j] = config.history_step[i - 1][j];
					}
				}
				sprintf(config.history_step[0], "%d/%d %d", (int)time.month, (int)time.day, (int)LSM6DSMGetCurrentStep());
				iWatchSaveConfig(&config);
				LSM6DSMResetStepCounter();
			}
			if(sleep_flag)
			{
				if(++autowake_cnt >= 1440)		//1440分钟 = 1天
				{
					autowake_cnt = 0;
					sleep_flag = 0;
					PCF8563EnableTimer(TIMERCLK_1_60_HZ, 10);	//自动唤醒频率改为10min一次，本来1min一次
					powerdown_flag = 1;
				}
			}
		}
	}
}
void iWatchAlwaysOn(void)
{
	BMPToCache(0, 0, 28, 64, watch_digit_num[time.hour/10], main_cache, 0);
	BMPToCache(28, 0, 28, 64, watch_digit_num[time.hour%10], main_cache, 0);
	BMPToCache(56, 0, 16, 64, watch_digit_colon, main_cache, 0);
	BMPToCache(72, 0, 28, 64, watch_digit_num[time.minute/10], main_cache, 0);
	BMPToCache(100, 0, 28, 64, watch_digit_num[time.minute%10], main_cache, 0);
	ScreenRefreshAll(main_cache);
}
void iWatchSleep(void)
{
	action = 0;
	active_flag = 0;
	inactive_time = 0;
	idle_flag = 0;
	idle_time = 0;
	powerdown_flag = 0;
	going_to_sleep_flag = 1;
}
void iWatchPowerDown(void)
{
	action = 0;
	active_flag = 0;
	inactive_time = 0;
	sleep_flag = 0;
	idle_flag = 0;
	idle_time = 0;
	powerdown_flag = 1;
}
void iWatchSaveConfig(iWatch_config *config)
{
	unsigned char i = 0;
	unsigned int temp = 0;
	for(i; i < CONFIG_SIZE - 2; i++)				//对结构体中每一字节求和
		temp += ((unsigned char *)config)[i];
	config->check_sum = temp;
	EEPROM_SectorErase(EE_ADDRESS1);				//将求和结果存放在结构体最后一个数字中
	EEPROM_write_n(EE_ADDRESS1, (unsigned char *)config, CONFIG_SIZE);
}
unsigned char iWatchReadConfig(iWatch_config *config)
{
	unsigned char i = 0;
	unsigned int temp = 0;
	EEPROM_read_n(EE_ADDRESS1, (unsigned char *)config, CONFIG_SIZE);
	for(i; i < CONFIG_SIZE - 2; i++)				//对结构体中每一字节求和
		temp += ((unsigned char *)config)[i];
	if(temp == config->check_sum)				//检验数据是否正确完整，结构体最后两字节为检验求和字节
		return 1;
	else
	{
		for(i = 0; i < CONFIG_SIZE; i++)
			((unsigned char *)config)[i] = ((unsigned char *)(&default_config))[i];
		return 0;
	}
}
/**
	* @brief 	测量当前电池剩余电量，测量结果已经过窗口滤波
	* @param  无
	* @retval percentage：剩余电量的百分比
	*/
#define	V_SHUTDOWN		3.4		//放电截止电压
#define	V_FULLCHARGE	4.13	//满电电压
#define	WINDOW_WIDTH	20		//窗口滤波宽度，适当的宽度使得电压百分比显示比较稳定
float iWatchGetBatteryLife(void)
{
	static bit first_time_flag = 0;
	static float queue[WINDOW_WIDTH];		//窗口滤波队列
	float queue_average = 0;						//队列均值
	float bat_v;
	float percentage;										//电量百分比
	unsigned char i = 0;
	bat_v = GetBatteryVoltage();
	if(bat_v >= 4.08)
		percentage = ((bat_v - 4.08) / (V_FULLCHARGE - 4.08)) * 0.1 + 0.9;
	else if(bat_v >= 4.00)
		percentage = ((bat_v - 4.00) / (4.08 - 4.00)) * 0.1 + 0.8;
	else if(bat_v >= 3.93)
		percentage = ((bat_v - 3.93) / (4.00 - 3.93)) * 0.1 + 0.7;
	else if(bat_v >= 3.87)
		percentage = ((bat_v - 3.87) / (3.93 - 3.87)) * 0.1 + 0.6;
	else if(bat_v >= 3.82)
		percentage = ((bat_v - 3.82) / (3.87 - 3.82)) * 0.1 + 0.5;
	else if(bat_v >= 3.79)
		percentage = ((bat_v - 3.79) / (3.82 - 3.79)) * 0.1 + 0.4;
	else if(bat_v >= 3.77)
		percentage = ((bat_v - 3.77) / (3.79 - 3.77)) * 0.1 + 0.3;
	else if(bat_v >= 3.73)
		percentage = ((bat_v - 3.73) / (3.77 - 3.73)) * 0.1 + 0.2;
	else if(bat_v >= 3.70)
		percentage = ((bat_v - 3.70) / (3.73 - 3.70)) * 0.05 + 0.15;
	else if(bat_v >= 3.68)
		percentage = ((bat_v - 3.68) / (3.70 - 3.68)) * 0.05 + 0.1;
	else if(bat_v >= 3.50)
		percentage = ((bat_v - 3.50) / (3.68 - 3.50)) * 0.05 + 0.05;
	else if(bat_v >= V_SHUTDOWN)
		percentage = ((bat_v - V_SHUTDOWN) / (3.50 - V_SHUTDOWN)) * 0.05;
	if(percentage > 1)
		percentage = 1;
	else if(percentage < 0)
		percentage = 0;
	if(first_time_flag == 0)						//若队列中没数据，初始化队列
	{
		first_time_flag = 1;
		for(i = 0; i < WINDOW_WIDTH; i++)
			queue[i] = percentage;
	}
	for(i = WINDOW_WIDTH - 1; i > 0; i--)
	{
		queue[i] = queue[i - 1];
		queue_average += queue[i];
	}
	queue_average += percentage;
	percentage = queue_average / WINDOW_WIDTH;
	queue[0] = percentage;
	return percentage;
}
void iWatchInit(void)
{
	iWatchReadConfig(&config);
	SysInit();						//系统初始化
	DisplayInit();				//显示初始化
	PCF8563Init();				//实时时钟初始化
	SensorInit();					//传感器初始化
	PageInit();
}