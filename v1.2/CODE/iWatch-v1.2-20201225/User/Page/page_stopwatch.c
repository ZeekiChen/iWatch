#include "iWatch.h"

extern unsigned char xdata main_cache[];
extern unsigned char xdata sub_cache[];

static PageExecuteRate_TypeDef Rate_1000hz = {1, 0};

static unsigned char code Text[] = "STOPWATCH";
static unsigned char code Icon[] = {
	0x00,0x00,0x00,0x00,0x00,0x00,0x00,0x00,0x00,0x00,0x00,0x00,0x00,0x00,0x00,0x00,
	0x00,0x00,0x00,0x00,0x3E,0x3E,0xFE,0xFE,0xFE,0xFE,0x3E,0x3E,0x00,0x00,0x00,0x00,
	0x00,0x00,0x00,0x00,0x00,0x00,0x00,0x00,0x00,0x00,0x00,0x00,0x00,0x00,0x00,0x00,
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	0x1E,0x1F,0x0F,0x07,0x03,0x03,0x00,0x00,0x00,0x00,0x00,0x00,0x00,0x00,0x00,0x00
	/* (48 X 48 )*/
};
unsigned char t = 0, t_x = 0, t_y = 2;
static int ms = 0, sec = 0, min = 0;
static unsigned char n = 0, x = 0, y = 2;
static unsigned char str1[10][11];
static unsigned char str2[10];
bit timer_on_flag = 0;			//计时器工作标志位
unsigned int timer_cnt = 0;	//定时器0溢出次数
void TM0_Isr() interrupt 1 using 1		//计数器0溢出中断
{
	timer_cnt++;
}
/**
  * @brief  页面初始化事件
  * @param  无
  * @retval 无
  */
static void Setup()
{
	ClearCache(sub_cache);
	ms = (timer_cnt * 65536 + ((TH0 << 8) | TL0)) / 10.24;
	sec = ms / 100 % 60;
	min = sec / 60;
	sprintf(str2, "%02d:%02d:%02d", min, sec % 60, ms % 100);
	ShowString(32, 0, str2, sub_cache, FONT8X16, NO_INVERSED);
	if(n != 0)
	{
		for(t = 0; t < n; t++)
		{
			if(t == 6)
			{				
				t_x = 64;
				t_y = 2;
			}
			ShowString(t_x, t_y++, str1[t], sub_cache, FONT6X8, NO_INVERSED);
		}
	}
	PageOpenAnim(ANIM_RIGHT);
}
/**
  * @brief  页面退出事件
  * @param  无
  * @retval 无
  */
static void Exit()
{
	PageCloseAnim(ANIM_RIGHT);
}
/**
  * @brief  页面循环执行的内容
  * @param  无
  * @retval 无
  */
static void Loop()
{
	if(PageExecuteRate(&Rate_1000hz) == 1)
	{
		ms = (timer_cnt * 65536 + ((TH0 << 8) | TL0)) / 10.24;
		sec = ms / 100;
		min = sec / 60;
		sprintf(str2, "%02d:%02d:%02d", min, sec % 60, ms % 100);
		ShowString(32, 0, str2, main_cache, FONT8X16, NO_INVERSED);
		//sleep_time = 0;
		ScreenRefreshAll(main_cache);
	}
}
/**
  * @brief  页面事件
  * @param  btn:发出事件的按键
  * @param  event:事件编号
  * @retval 无
  */
static void Event(unsigned char event)
{
	if(event == KEY1)
		PageShift(page_menu);
	else if(event == KEY2)
	{
		if(TR0)
		{
			TR0 = 0;
			PCF8563EnableClockOuput(CLKOUT_1024_HZ, DISABLE_CLKOUT);
			timer_on_flag = 0;
		}
		else
		{
			PCF8563EnableClockOuput(CLKOUT_1024_HZ, ENABLE_CLKOUT);
			TR0 = 1;
			timer_on_flag = 1;
		}
	}
	else if(event == KEY3)
	{
		timer_cnt = 0;
		TH0 = 0;
		TL0 = 0;
		ms = 0;
		sec = 0;
		min = 0;
		n = 0;
		x = 0;
		y = 2;
		ClearCache(main_cache);
	}
	else if(event == DOUBLE_TAP)
	{
		if(n < 9 && timer_on_flag == 1)
		{
			if(n == 6)
			{
				x = 64;
				y = 2;
			}
			sprintf(str1[n], "%d.%02d:%02d:%02d\0", (int)(n + 1), min, sec % 60, ms % 100);
			ShowString(x + 0, y++, str1[n++], main_cache, FONT6X8, NO_INVERSED);
			ScreenRefreshAll(main_cache);
		}
	}
}

void PageRegister_page_stopwatch(unsigned char pageID)
{
	PageRegister(pageID, Text, Icon, Setup, Loop, Exit, Event);
}