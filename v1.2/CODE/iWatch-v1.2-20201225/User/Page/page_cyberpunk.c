#include "iWatch.h"

extern unsigned char xdata main_cache[];
extern unsigned char xdata sub_cache[];

static PageExecuteRate_TypeDef Rate_50hz = {20, 0};

static unsigned char code Text[] = "CYBERPUNK2077";
static unsigned char code Icon[] = {
	0xFF,0xFF,0xFF,0xFF,0xFF,0xFF,0xFF,0xFF,0xFF,0xFF,0xFF,0xFF,0xFF,0xFF,0xFF,0xFF,
	0xFF,0xFF,0xFF,0xFF,0xFF,0xFF,0xFF,0xFF,0xFF,0xFF,0xFF,0xFF,0xFF,0xFF,0xFF,0xFF,
	0xFF,0xFF,0xFF,0xFF,0xFF,0xFF,0xFF,0xFF,0xFF,0xFF,0xFF,0xFF,0xFF,0xFF,0xFF,0xFF,
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	0xFF,0xFF,0xFF,0xFF,0xFF,0xFF,0xFF,0xFF,0xFF,0xFF,0xFF,0xFF,0xFF,0xFF,0xFF,0xFF
	/* (48 X 48 )*/
};

static unsigned int rx_buf_num = 0;
bit frame_received_flag = 0;
bit serial_busy = 0;
void UartInit_1(void)		//576000bps@24.000MHz
{
	SCON = 0x50;		//8???,?????
	AUXR |= 0x40;		//???1???Fosc,?1T
	AUXR &= 0xFE;		//??1?????1???????
	TMOD &= 0x0F;		//?????1?16???????
	TL1 = 0xF6;		//??????
	TH1 = 0xFF;		//??????
	ET1 = 0;		//?????1??
	TR1 = 1;		//?????1
	ES = 1;					//开串口中断
	TI = 0;
	RI = 0;
}
void UART1_Isr() interrupt 4 using 1
{
	if(RI)
	{
		RI = 0;
		main_cache[rx_buf_num++] = SBUF;
		if(rx_buf_num == 1024)
		{
			rx_buf_num = 0;
			frame_received_flag = 1;
		}
	}
	if(TI)
	{
		TI = 0;
		serial_busy = 0;
	}
}
void UART1SendString(char *str)
{
	while(*str)
  {
		while(serial_busy);
		serial_busy = 1;
		SBUF = *str++;
  }
}
void StartFrameReceive()
{
	UART1SendString("ok");
	frame_received_flag = 0;
	rx_buf_num = 0;
}
/**
  * @brief  页面初始化事件
  * @param  无
  * @retval 无
  */
static void Setup()
{
	ClearCache(sub_cache);
	ShowString(12, 2, "PRESS KEY2 TO", sub_cache, FONT8X16, NO_INVERSED);
	ShowString(44, 4, "START", sub_cache, FONT8X16, NO_INVERSED);
	UartInit_1();
	PageOpenAnim(ANIM_RIGHT);
}
/**
  * @brief  页面退出事件
  * @param  无
  * @retval 无
  */
static void Exit()
{
	UartInit();
	PageCloseAnim(ANIM_RIGHT);
}
/**
  * @brief  页面循环执行的内容
  * @param  无
  * @retval 无
  */
static void Loop()
{
	iWatchKeepActive();
	if(frame_received_flag)
	{
		OLED_Refresh(main_cache);
		StartFrameReceive();
	}
}
/**
  * @brief  页面事件
  * @param  btn:发出事件的按键
  * @param  event:事件编号
  * @retval 无
  */
static void Event(unsigned char event)
{
	if(event == KEY1)
		PageShift(page_menu);
	else if(event == KEY2)
		StartFrameReceive();
}

void PageRegister_page_cyberpunk(unsigned char pageID)
{
	PageRegister(pageID, Text, Icon, Setup, Loop, Exit, Event);
}